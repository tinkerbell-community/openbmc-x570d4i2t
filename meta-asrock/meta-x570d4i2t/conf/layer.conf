## meta-asrock/meta-x570d4i2t/conf/layer.conf
```bitbake
# We have a conf and classes directory, add to BBPATH
BBPATH .= ":${LAYERDIR}"

# We have recipes-* directories, add to BBFILES
BBFILES += "${LAYERDIR}/recipes-*/*/*.bb \
            ${LAYERDIR}/recipes-*/*/*.bbappend"

BBFILE_COLLECTIONS += "x570d4i2t-layer"
BBFILE_PATTERN_x570d4i2t-layer := "^${LAYERDIR}/"
LAYERSERIES_COMPAT_x570d4i2t-layer = "wrynose whinlatter"
```
